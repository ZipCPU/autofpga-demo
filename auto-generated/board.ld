/*******************************************************************************
*
* Filename:	../auto-generated/board.ld
*
* Project:	AutoFPGA basic peripheral demonstration project
*
* DO NOT EDIT THIS FILE!
* Computer Generated: This file is computer generated by AUTOFPGA. DO NOT EDIT.
* DO NOT EDIT THIS FILE!
*
* CmdLine:	/home/dan/work/rnd/opencores/autofpga/trunk/sw/autofpga /home/dan/work/rnd/opencores/autofpga/trunk/sw/autofpga -o ../auto-generated global.txt bkram.txt buserr.txt clock.txt hexbus.txt fixdata.txt pwrcount.txt rawreg.txt simhalt.txt version.txt
*
* Creator:	Dan Gisselquist, Ph.D.
*		Gisselquist Technology, LLC
*
/*******************************************************************************
*
* Copyright (C) 2017, Gisselquist Technology, LLC
*
* This file is part of the AutoFPGA peripheral demonstration project.
*
* The AutoFPGA peripheral demonstration project is free software (firmware):
* you can redistribute it and/or modify it under the terms of the GNU Lesser
* General Public License as published by the Free Software Foundation, either
* version 3 of the License, or (at your option) any later version.
*
* The AutoFPGA peripheral demonstration project is distributed in the hope
* that it will be useful, but WITHOUT ANY WARRANTY; without even the implied
* warranty of MERCHANTIBILITY or FITNESS FOR A PARTICULAR PURPOSE.  See the
* GNU Lesser General Public License for more details.
*
* You should have received a copy of the GNU Lesser General Public License
* along with this program.  (It's in the $(ROOT)/doc directory.  Run make
* with no target there if the PDF file isn't present.)  If not, see
* <http://www.gnu.org/licenses/> for a copy.
*
* License:	LGPL, v3, as defined and found on www.gnu.org,
*		http://www.gnu.org/licenses/lgpl.html
*
*
/*******************************************************************************
*
*
*/
ENTRY(_start)

MEMORY
{
	   bkram(wx) : ORIGIN = 0x00100000, LENGTH = 0x00100000
}

_bkram    = ORIGIN(bkram);
SECTIONS
{
	.rocode 0x00000000 : ALIGN(4) {
		_boot_address = .;
		*(.start) *(.boot)
	} > flash
	_kernel_image_start = . ;
	_kernel_image_end = . ;
	_ram_image_start = . ;
	.ramcode : ALIGN_WITH_INPUT {
		*(.kernel)
		*(.text.startup)
		*(.text*)
		*(.rodata*) *(.strings)
		*(.data) *(COMMON)
		}> bkram AT> flash
	_ram_image_end = . ;
	.bss : ALIGN_WITH_INPUT {
		*(.bss)
		_bss_image_end = . ;
		} > bkram
	_top_of_heap = .;
}
